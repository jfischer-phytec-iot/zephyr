## boards/arm/reel_board_wb55rg/Kconfig.board
```kconfig
# Kconfig - reel board wb55rg configuration
#
# Copyright (c) 2019 PHYTEC Messtechnik GmbH
#
# SPDX-License-Identifier: Apache-2.0
#

config BOARD_REEL_BOARD_WB55RG
	bool "reel board wb55rg Development Board"
	depends on SOC_STM32WB55XX
```

## boards/arm/reel_board_wb55rg/Kconfig.defconfig
```kconfig
# Kconfig - reel board wb55rg configuration
#
# Copyright (c) 2019 Linaro Limited
# Copyright (c) 2019 PHYTEC Messtechnik GmbH
#
# SPDX-License-Identifier: Apache-2.0
#

if BOARD_REEL_BOARD_WB55RG

config BOARD
	default "reel_board_wb55rg"

config CLOCK_STM32_LSE
	default y

if UART_CONSOLE

config UART_1
	default y

endif # UART_CONSOLE

if SERIAL

config LPUART_1
	default y

endif # SERIAL

if I2C

config I2C_1
	default y

config I2C_STM32_INTERRUPT
	default y

endif # I2C

if SPI

config SPI_1
	default y

config SPI_2
	default y

endif # SPI

if ADC

config ADC_1
	default y

endif # ADC

if BT_DEBUG_MONITOR

config LPUART_1
	default y

endif # BT_DEBUG_MONITOR

if BT

choice BT_HCI_BUS_TYPE
	default BT_STM32_IPM

endchoice

endif # BT

endif # BOARD_REEL_BOARD_WB55RG
```

## dts/bindings/sensor/sbs-gauge.yaml
```yaml
description: SBS 1.1 compliant fuel gauge (http://www.sbs-forum.org/specs)

compatible: "sbs-gauge"

include: i2c-device.yaml
```

## samples/subsys/usb/hid_issue_sample/Kconfig
```kconfig
# SPDX-License-Identifier: Apache-2.0

config USB_DEVICE_PID
	default 0x000E

source "Kconfig.zephyr"
```
