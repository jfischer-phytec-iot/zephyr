/*
 * Copyright (c) 2021 Nordic Semiconductor ASA
 *
 * SPDX-License-Identifier: Apache-2.0
 */

/ {
	chosen {
		zephyr,console = &cdc_acm_uart0;
	};

	cdc_acm_uart0: uart {
		status = "okay";
		compatible = "zephyr,cdc-acm-uart";
		label = "CDC_ACM_0";
	};
};
